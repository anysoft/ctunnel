## Kconfig
```kconfig
mainmenu "ctunnel configuration"

config CTUNNEL_TARGET_OS
	string
	option env="CTUNNEL_TARGET_OS"

config TARGET_LINUX
	bool
	default y if CTUNNEL_TARGET_OS = "linux"

config TARGET_DARWIN
	bool
	default y if CTUNNEL_TARGET_OS = "darwin" || CTUNNEL_TARGET_OS = "macos"

config TARGET_BSD
	bool
	default y if CTUNNEL_TARGET_OS = "freebsd" || CTUNNEL_TARGET_OS = "openbsd" || CTUNNEL_TARGET_OS = "netbsd"

config TARGET_WINDOWS
	bool
	default y if CTUNNEL_TARGET_OS = "windows"

menu "Build profile"

choice
	prompt "Binary role"
	default CTUNNEL_ROLE_BOTH

config CTUNNEL_ROLE_BOTH
	bool "Client and server"

config CTUNNEL_ROLE_CLIENT_ONLY
	bool "Client only"

config CTUNNEL_ROLE_SERVER_ONLY
	bool "Server only"

endchoice

config CTUNNEL_CLIENT
	bool
	default y if CTUNNEL_ROLE_BOTH || CTUNNEL_ROLE_CLIENT_ONLY

config CTUNNEL_SERVER
	bool
	default y if CTUNNEL_ROLE_BOTH || CTUNNEL_ROLE_SERVER_ONLY

config OPTIMIZE_FOR_SIZE
	bool "Optimize executable for minimum size"
	default n

config ENABLE_LTO
	bool "Enable link-time optimization"
	default n

config ENABLE_SECTION_GC
	bool "Discard unused functions and data"
	default y

endmenu

choice
	prompt "Link mode"
	default CTUNNEL_LINK_MOSTLY_STATIC

config CTUNNEL_LINK_DYNAMIC
	bool "Dynamic"
	help
	  Use the platform's default dynamic C runtime. Monocypher is still
	  compiled into the ctunnel executable.

config CTUNNEL_LINK_MOSTLY_STATIC
	bool "Mostly static"
	help
	  Compile ctunnel and Monocypher into one executable while allowing
	  the platform C runtime and other system runtime libraries to remain
	  dynamic. This is the recommended embedded glibc/OpenWrt default.

config CTUNNEL_LINK_STATIC
	bool "Fully static"
	help
	  Request a static user-space runtime. Linux requires a target SDK
	  containing the required static libc archives; macOS does not support
	  this mode. Windows uses a static CRT but retains system DLLs.

endchoice

source "src/Kconfig"
```

## configs/default_defconfig
```kconfig
CONFIG_CTUNNEL_ROLE_BOTH=y
CONFIG_ENABLE_SECTION_GC=y
CONFIG_CTUNNEL_LINK_MOSTLY_STATIC=y
CONFIG_FEATURE_IPV4=y
CONFIG_FEATURE_IPV6=y
CONFIG_FEATURE_TCP=y
CONFIG_CRYPTO_MONOCYPHER=y
CONFIG_CRYPTO_CHACHA20_POLY1305=y
CONFIG_FEATURE_PUBLIC_KEY_AUTH=y
CONFIG_FEATURE_DATA_ENCRYPTION=y
CONFIG_FEATURE_WORK_CONNECTION=y
CONFIG_FEATURE_WORK_POOL=y
CONFIG_FEATURE_KEYGEN=y
CONFIG_FEATURE_FINGERPRINT=y
CONFIG_FEATURE_CONFIG_TEST=y
CONFIG_FEATURE_BUILD_INFO=y
CONFIG_FEATURE_VERBOSE_HELP=y
CONFIG_FEATURE_COMMAND_LINE_OVERRIDE=y
CONFIG_LOG_MAX_LEVEL_INFO=y
CONFIG_MAX_CLIENTS=4
CONFIG_MAX_SERVICES=16
CONFIG_MAX_STREAMS=64
CONFIG_MAX_PENDING_STREAMS=16
CONFIG_MAX_FRAME_SIZE=1048576
CONFIG_STREAM_BUFFER_SIZE=65536
CONFIG_CONTROL_BUFFER_SIZE=4096
CONFIG_DEFAULT_MAX_STREAMS=64
CONFIG_DEFAULT_MAX_PENDING_STREAMS=16
CONFIG_DEFAULT_POOL_COUNT=2
CONFIG_DEFAULT_POOL_MIN=1
CONFIG_DEFAULT_POOL_MAX=8
```

## configs/full_defconfig
```kconfig
CONFIG_CTUNNEL_ROLE_BOTH=y
CONFIG_ENABLE_SECTION_GC=y
CONFIG_CTUNNEL_LINK_MOSTLY_STATIC=y
CONFIG_FEATURE_IPV4=y
CONFIG_FEATURE_IPV6=y
CONFIG_FEATURE_TCP=y
CONFIG_FEATURE_UDP=y
CONFIG_FEATURE_PROXY_PROTOCOL=y
CONFIG_FEATURE_PROXY_PROTOCOL_V1=y
CONFIG_FEATURE_PROXY_PROTOCOL_V2=y
CONFIG_CRYPTO_MONOCYPHER=y
CONFIG_CRYPTO_CHACHA20_POLY1305=y
CONFIG_FEATURE_PUBLIC_KEY_AUTH=y
CONFIG_FEATURE_DATA_ENCRYPTION=y
CONFIG_FEATURE_WORK_CONNECTION=y
CONFIG_FEATURE_WORK_POOL=y
CONFIG_FEATURE_KEYGEN=y
CONFIG_FEATURE_FINGERPRINT=y
CONFIG_FEATURE_CONFIG_TEST=y
CONFIG_FEATURE_BUILD_INFO=y
CONFIG_FEATURE_VERBOSE_HELP=y
CONFIG_FEATURE_ENV_OVERRIDE=y
CONFIG_FEATURE_COMMAND_LINE_OVERRIDE=y
CONFIG_LOG_MAX_LEVEL_DEBUG=y
CONFIG_FEATURE_ASSERTIONS=y
CONFIG_FEATURE_PROTOCOL_DIAGNOSTICS=y
CONFIG_FEATURE_TEST_HOOKS=y
CONFIG_MAX_CLIENTS=64
CONFIG_MAX_SERVICES=128
CONFIG_MAX_STREAMS=512
CONFIG_MAX_PENDING_STREAMS=256
CONFIG_MAX_FRAME_SIZE=1048576
CONFIG_MAX_CLIENT_ID_LENGTH=128
CONFIG_MAX_SERVICE_ID_LENGTH=128
CONFIG_MAX_ADDRESS_LENGTH=256
CONFIG_MAX_PATH_LENGTH=1024
CONFIG_MAX_PORT_RANGES=64
CONFIG_STREAM_BUFFER_SIZE=131072
CONFIG_CONTROL_BUFFER_SIZE=16384
CONFIG_DEFAULT_MAX_STREAMS=512
CONFIG_DEFAULT_MAX_PENDING_STREAMS=256
CONFIG_DEFAULT_POOL_COUNT=16
CONFIG_DEFAULT_POOL_MIN=4
CONFIG_DEFAULT_POOL_MAX=32
```

## configs/linux_defconfig
```kconfig
CONFIG_CTUNNEL_ROLE_BOTH=y
CONFIG_FEATURE_IPV4=y
CONFIG_FEATURE_IPV6=y
CONFIG_EVENT_EPOLL=y
CONFIG_LOG_MAX_LEVEL_INFO=y
```

## configs/macos_defconfig
```kconfig
CONFIG_CTUNNEL_ROLE_BOTH=y
CONFIG_FEATURE_IPV4=y
CONFIG_FEATURE_IPV6=y
CONFIG_EVENT_KQUEUE=y
CONFIG_LOG_MAX_LEVEL_INFO=y
```

## configs/mini_client_defconfig
```kconfig
CONFIG_CTUNNEL_ROLE_CLIENT_ONLY=y
CONFIG_OPTIMIZE_FOR_SIZE=y
CONFIG_ENABLE_LTO=y
CONFIG_ENABLE_SECTION_GC=y
CONFIG_CTUNNEL_LINK_MOSTLY_STATIC=y
# CONFIG_FEATURE_IPV4 is not set
CONFIG_FEATURE_IPV6=y
CONFIG_FEATURE_TCP=y
CONFIG_CRYPTO_MONOCYPHER=y
CONFIG_CRYPTO_CHACHA20_POLY1305=y
CONFIG_FEATURE_PUBLIC_KEY_AUTH=y
# CONFIG_FEATURE_DATA_ENCRYPTION is not set
CONFIG_FEATURE_WORK_CONNECTION=y
CONFIG_FEATURE_WORK_POOL=y
# CONFIG_FEATURE_KEYGEN is not set
# CONFIG_FEATURE_FINGERPRINT is not set
# CONFIG_FEATURE_CONFIG_TEST is not set
# CONFIG_FEATURE_BUILD_INFO is not set
# CONFIG_FEATURE_VERBOSE_HELP is not set
# CONFIG_FEATURE_ENV_OVERRIDE is not set
# CONFIG_FEATURE_COMMAND_LINE_OVERRIDE is not set
CONFIG_LOG_MAX_LEVEL_WARN=y
CONFIG_MAX_CLIENTS=1
CONFIG_MAX_SERVICES=4
CONFIG_MAX_STREAMS=8
CONFIG_MAX_PENDING_STREAMS=4
CONFIG_MAX_FRAME_SIZE=16384
CONFIG_MAX_CLIENT_ID_LENGTH=32
CONFIG_MAX_SERVICE_ID_LENGTH=32
CONFIG_MAX_ADDRESS_LENGTH=64
CONFIG_MAX_PATH_LENGTH=256
CONFIG_MAX_PORT_RANGES=8
CONFIG_STREAM_BUFFER_SIZE=16384
CONFIG_CONTROL_BUFFER_SIZE=1024
CONFIG_DEFAULT_MAX_STREAMS=8
CONFIG_DEFAULT_MAX_PENDING_STREAMS=4
CONFIG_DEFAULT_POOL_COUNT=1
CONFIG_DEFAULT_POOL_MIN=1
CONFIG_DEFAULT_POOL_MAX=2
```

## configs/openwrt_mini_defconfig
```kconfig
CONFIG_CTUNNEL_ROLE_SERVER_ONLY=y
CONFIG_OPTIMIZE_FOR_SIZE=y
CONFIG_ENABLE_LTO=y
CONFIG_ENABLE_SECTION_GC=y
CONFIG_CTUNNEL_LINK_MOSTLY_STATIC=y
# CONFIG_FEATURE_IPV4 is not set
CONFIG_FEATURE_IPV6=y
CONFIG_EVENT_EPOLL=y
# CONFIG_FEATURE_DATA_ENCRYPTION is not set
CONFIG_FEATURE_WORK_POOL=y
# CONFIG_FEATURE_KEYGEN is not set
# CONFIG_FEATURE_FINGERPRINT is not set
# CONFIG_FEATURE_CONFIG_TEST is not set
# CONFIG_FEATURE_BUILD_INFO is not set
# CONFIG_FEATURE_VERBOSE_HELP is not set
CONFIG_LOG_MAX_LEVEL_WARN=y
CONFIG_MAX_CLIENTS=1
CONFIG_MAX_SERVICES=4
CONFIG_MAX_STREAMS=8
CONFIG_MAX_PENDING_STREAMS=4
CONFIG_STREAM_BUFFER_SIZE=16384
CONFIG_CONTROL_BUFFER_SIZE=1024
```

## configs/windows_defconfig
```kconfig
CONFIG_CTUNNEL_ROLE_BOTH=y
CONFIG_FEATURE_IPV4=y
CONFIG_FEATURE_IPV6=y
CONFIG_FEATURE_TCP=y
CONFIG_FEATURE_UDP=y
CONFIG_FEATURE_PROXY_PROTOCOL=y
CONFIG_FEATURE_PROXY_PROTOCOL_V1=y
CONFIG_FEATURE_PROXY_PROTOCOL_V2=y
CONFIG_EVENT_WSAPOLL=y
CONFIG_LOG_MAX_LEVEL_INFO=y
```

## packaging/buildroot/ctunnel/Config.in
```kconfig
config BR2_PACKAGE_CTUNNEL
	bool "ctunnel"
	help
	  Lightweight authenticated reverse TCP tunnel with bundled Monocypher.

if BR2_PACKAGE_CTUNNEL

config BR2_PACKAGE_CTUNNEL_SERVER_ONLY
	bool "server-only binary"
	default y

config BR2_PACKAGE_CTUNNEL_IPV6_ONLY
	bool "IPv6 only"
	default y

config BR2_PACKAGE_CTUNNEL_MINI
	bool "minimum-size feature profile"
	default y

choice
	prompt "ctunnel link mode"
	default BR2_PACKAGE_CTUNNEL_LINK_MOSTLY_STATIC

config BR2_PACKAGE_CTUNNEL_LINK_DYNAMIC
	bool "dynamic"

config BR2_PACKAGE_CTUNNEL_LINK_MOSTLY_STATIC
	bool "mostly static (recommended)"
	help
	  Compile ctunnel and Monocypher into the executable while reusing
	  the target libc/runtime.

config BR2_PACKAGE_CTUNNEL_LINK_STATIC
	bool "fully static"
	help
	  Requires all target libc/compiler runtime static archives in the
	  selected Buildroot SDK. musl is preferred; glibc can be much larger.

endchoice

endif
```

## src/Kconfig
```kconfig
source "src/client/Kconfig"
source "src/server/Kconfig"
source "src/net/Kconfig"
source "src/crypto/Kconfig"
source "src/config/Kconfig"
source "src/log/Kconfig"
source "src/platform/Kconfig"
source "src/tools/Kconfig"

menu "Compile-time resource limits"

config MAX_CLIENTS
	int "Maximum authorized clients"
	range 1 64
	default 4

config MAX_SERVICES
	int "Maximum services"
	range 1 256
	default 32

config MAX_STREAMS
	int "Maximum concurrent streams"
	range 1 4096
	default 256

config MAX_PENDING_STREAMS
	int "Maximum pending public connections"
	range 1 1024
	default 256

config MAX_UDP_SESSIONS
	int "Maximum UDP pseudo sessions"
	range 1 8192
	default 1024

config MAX_UDP_DATAGRAM_SIZE
	int "Maximum UDP datagram payload size"
	range 512 65507
	default 1472

config UDP_REPLAY_WINDOW
	int "UDP replay window"
	range 64 128
	default 64

config MAX_FRAME_SIZE
	int "Maximum protocol frame size"
	range 4096 1048576
	default 1048576

config MAX_CLIENT_ID_LENGTH
	int "Maximum client ID length"
	range 8 256
	default 64

config MAX_SERVICE_ID_LENGTH
	int "Maximum service ID length"
	range 8 256
	default 64

config MAX_ADDRESS_LENGTH
	int "Maximum address length"
	range 16 512
	default 128

config MAX_PATH_LENGTH
	int "Maximum path length"
	range 64 2048
	default 512

config MAX_PORT_RANGES
	int "Maximum authorized port ranges"
	range 1 128
	default 32

config STREAM_BUFFER_SIZE
	int "Relay I/O buffer size"
	range 4096 262144
	default 65536

config CONTROL_BUFFER_SIZE
	int "Control-channel scratch buffer size"
	range 256 65536
	default 4096

config DEFAULT_MAX_STREAMS
	int "Default runtime stream limit"
	range 1 MAX_STREAMS
	default 256

config DEFAULT_MAX_PENDING_STREAMS
	int "Default runtime pending limit"
	range 1 MAX_PENDING_STREAMS
	default 256

config DEFAULT_POOL_COUNT
	int "Default idle work-connection pool"
	range 0 64
	default 16 if FEATURE_WORK_POOL
	default 0

config DEFAULT_POOL_MIN
	int "Default minimum work-connection pool"
	range 0 64
	default 4 if FEATURE_WORK_POOL
	default 0

config DEFAULT_POOL_MAX
	int "Default maximum work-connection pool"
	range 0 64
	default 32 if FEATURE_WORK_POOL
	default 0

config MINI_MAX_BINARY_SIZE_KIB
	int "Maximum stripped Mini binary size (KiB)"
	range 64 2048
	default 400

endmenu

menu "Development diagnostics"

config FEATURE_ASSERTIONS
	bool "Internal assertions"
	default n

config FEATURE_PROTOCOL_DIAGNOSTICS
	bool "Detailed protocol diagnostics"
	default n

config FEATURE_TEST_HOOKS
	bool "Test-only hooks"
	default n

endmenu
```

## src/client/Kconfig
```kconfig
menu "Client"
	depends on CTUNNEL_CLIENT

config FEATURE_CLIENT_RECONNECT
	bool "Automatic reconnect"
	default y

endmenu
```

## src/config/Kconfig
```kconfig
menu "Runtime configuration"

config FEATURE_INI_CONFIG
	bool "INI configuration files"
	default y

config FEATURE_ENV_OVERRIDE
	bool "Environment-variable overrides"
	default n

config FEATURE_COMMAND_LINE_OVERRIDE
	bool "Command-line overrides"
	default y

config FEATURE_UNKNOWN_CONFIG_ERROR
	bool "Reject unknown configuration keys"
	default y

endmenu
```

## src/crypto/Kconfig
```kconfig
menu "Cryptography"

config CRYPTO_MONOCYPHER
	bool "Monocypher backend"
	default y

config CRYPTO_CHACHA20_POLY1305
	bool "XChaCha20-Poly1305 control-channel AEAD"
	depends on CRYPTO_MONOCYPHER
	default y

config FEATURE_PUBLIC_KEY_AUTH
	bool "Ed25519 public-key authentication"
	depends on CRYPTO_MONOCYPHER
	default y

config FEATURE_DATA_ENCRYPTION
	bool "Encrypted relay data"
	depends on CRYPTO_CHACHA20_POLY1305
	default y

endmenu
```

## src/log/Kconfig
```kconfig
menu "Logging"

choice
	prompt "Maximum compiled log level"
	default LOG_MAX_LEVEL_INFO

config LOG_MAX_LEVEL_ERROR
	bool "Error"

config LOG_MAX_LEVEL_WARN
	bool "Warn"

config LOG_MAX_LEVEL_INFO
	bool "Info"

config LOG_MAX_LEVEL_DEBUG
	bool "Debug"

config LOG_MAX_LEVEL_TRACE
	bool "Trace"

endchoice

config LOG_ERROR
	bool
	default y

config LOG_WARN
	bool
	default y if !LOG_MAX_LEVEL_ERROR

config LOG_INFO
	bool
	default y if LOG_MAX_LEVEL_INFO || LOG_MAX_LEVEL_DEBUG || LOG_MAX_LEVEL_TRACE

config LOG_DEBUG
	bool
	default y if LOG_MAX_LEVEL_DEBUG || LOG_MAX_LEVEL_TRACE

config LOG_TRACE
	bool
	default y if LOG_MAX_LEVEL_TRACE

endmenu
```

## src/net/Kconfig
```kconfig
menu "Network"

config FEATURE_TCP
	bool "TCP forwarding"
	default y

config FEATURE_UDP
	bool "UDP forwarding"
	default y

config FEATURE_PROXY_PROTOCOL
	bool "PROXY Protocol support"
	default y
	help
	  Allow TCP services to prepend HAProxy PROXY Protocol metadata to
	  client-side local backend connections.

config FEATURE_PROXY_PROTOCOL_V1
	bool "PROXY Protocol v1"
	depends on FEATURE_PROXY_PROTOCOL
	default y

config FEATURE_PROXY_PROTOCOL_V2
	bool "PROXY Protocol v2"
	depends on FEATURE_PROXY_PROTOCOL
	default y

config FEATURE_IPV4
	bool "IPv4"
	default y

config FEATURE_IPV6
	bool "IPv6"
	default y

config FEATURE_WORK_CONNECTION
	bool "On-demand work connections"
	default y

config FEATURE_WORK_POOL
	bool "Idle work-connection pool"
	depends on FEATURE_WORK_CONNECTION
	default y

endmenu
```

## src/platform/Kconfig
```kconfig
menu "Platform"

choice
	prompt "Event backend"
	default EVENT_EPOLL if TARGET_LINUX
	default EVENT_KQUEUE if TARGET_DARWIN || TARGET_BSD
	default EVENT_WSAPOLL if TARGET_WINDOWS
	default EVENT_POLL

config EVENT_EPOLL
	bool "epoll (Linux)"
	depends on TARGET_LINUX

config EVENT_KQUEUE
	bool "kqueue (BSD/macOS)"
	depends on TARGET_DARWIN || TARGET_BSD

config EVENT_POLL
	bool "poll (portable POSIX)"
	depends on !TARGET_WINDOWS

config EVENT_WSAPOLL
	bool "WSAPoll (Windows)"
	depends on TARGET_WINDOWS

endchoice

config FEATURE_TCP_KEEPALIVE_TUNING
	bool "TCP keepalive tuning"
	default y

config FEATURE_SIGNAL_HANDLING
	bool "POSIX signal handling"
	default y

endmenu
```

## src/server/Kconfig
```kconfig
menu "Server"
	depends on CTUNNEL_SERVER

comment "Server control and public listeners are mandatory in phase 1"

endmenu
```

## src/tools/Kconfig
```kconfig
menu "Optional applets"

config FEATURE_KEYGEN
	bool "keygen applet"
	depends on CRYPTO_MONOCYPHER
	default y

config FEATURE_FINGERPRINT
	bool "fingerprint applet"
	depends on CRYPTO_MONOCYPHER
	default y

config FEATURE_CONFIG_TEST
	bool "configtest applet"
	default y

config FEATURE_BUILD_INFO
	bool "build-info/build-config applets"
	default y

config FEATURE_VERBOSE_HELP
	bool "Verbose command help"
	default y

endmenu
```
